## field-tool/sdkconfig.defaults
```kconfig
# Target
CONFIG_IDF_TARGET="esp32p4"

# Flash
CONFIG_ESPTOOLPY_FLASHMODE_QIO=y
CONFIG_ESPTOOLPY_FLASHSIZE_16MB=y
CONFIG_PARTITION_TABLE_CUSTOM=y

# Performance
CONFIG_COMPILER_OPTIMIZATION_PERF=y

# PSRAM (32MB)
CONFIG_SPIRAM=y
CONFIG_SPIRAM_SPEED_200M=y
CONFIG_SPIRAM_XIP_FROM_PSRAM=y
CONFIG_SPIRAM_USE_CAPS_ALLOC=y
CONFIG_FREERTOS_TASK_CREATE_ALLOW_EXT_MEM=n

# Cache (128KB L2 frees 128KB internal SRAM for DMA — needed for WiFi SDIO + USB Host)
CONFIG_CACHE_L2_CACHE_128KB=y
CONFIG_CACHE_L2_CACHE_LINE_128B=y

# FreeRTOS
CONFIG_ESP_MAIN_TASK_STACK_SIZE=10240
CONFIG_FREERTOS_HZ=1000

# LVGL
CONFIG_LV_USE_CLIB_MALLOC=y
CONFIG_LV_USE_CLIB_STRING=y
CONFIG_LV_USE_CLIB_SPRINTF=y
CONFIG_LV_DEF_REFR_PERIOD=15
CONFIG_LV_OS_FREERTOS=y
CONFIG_LV_DRAW_SW_DRAW_UNIT_CNT=2
CONFIG_LV_ATTRIBUTE_FAST_MEM_USE_IRAM=y
CONFIG_LV_FONT_MONTSERRAT_12=y
CONFIG_LV_FONT_MONTSERRAT_14=y
CONFIG_LV_FONT_MONTSERRAT_16=y
CONFIG_LV_FONT_MONTSERRAT_20=y
CONFIG_LV_FONT_MONTSERRAT_24=y
CONFIG_LV_COLOR_DEPTH_16=y

# WiFi via C6 coprocessor (SDIO transport, matching Waveshare board schematic)
CONFIG_ESP_WIFI_SOFTAP_SUPPORT=y
CONFIG_SLAVE_IDF_TARGET_ESP32C6=y
CONFIG_ESP_HOSTED_SDIO_HOST_INTERFACE=y

# Experimental features (needed for P4)
CONFIG_IDF_EXPERIMENTAL_FEATURES=y

# GigaDevice flash support (silence warnings)
CONFIG_SPI_FLASH_SUPPORT_GD_CHIP=y

# FAT filesystem — enable long filenames
CONFIG_FATFS_LFN_HEAP=y
CONFIG_FATFS_MAX_LFN=255

# USB Host — use PSRAM for DMA buffers (frees internal RAM for SDIO + WiFi)
CONFIG_USB_HOST_DWC_DMA_CAP_MEMORY_IN_PSRAM=y

# Serial flasher — USB CDC-ACM interface (flash via CH340 USB bridge)
CONFIG_SERIAL_FLASHER_INTERFACE_USB=y
CONFIG_SERIAL_FLASHER_MD5_ENABLED=y
```
